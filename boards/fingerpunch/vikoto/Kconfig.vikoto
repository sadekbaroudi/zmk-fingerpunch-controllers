## boards/fingerpunch/vikoto/Kconfig.vikoto
```kconfig
# vikoto board configuration

# Copyright (c) 2020 The ZMK Contributors
# SPDX-License-Identifier: MIT

config BOARD_VIKOTO
    select SOC_NRF52840_QIAA
    imply RETAINED_MEM
    imply RETENTION
    imply RETENTION_BOOT_MODE
```

## boards/fingerpunch/xivik/board.yml
```yaml
board:
  name: xivik
  vendor: fingerpunch
  revision:
    format: major.minor.patch
    default: 0.3.0
    exact: true
    revisions:
    - name: 0.1.0
    - name: 0.2.0
    - name: 0.3.0
  socs:
  - name: rp2040
```
