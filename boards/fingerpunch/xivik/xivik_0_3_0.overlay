#include "0_3_0/seeed_xiao_connector.dtsi"
#include "0_3_0/vik_connector.dtsi"
#include "0_3_0/xivik-pinctl.dtsi"

&i2c1 {
	pinctrl-0 = <&i2c1_default>;
	pinctrl-names = "default";
	clock-frequency = <I2C_BITRATE_FAST>;
};

&spi0 {
	pinctrl-0 = <&spi0_default>;
	pinctrl-names = "default";
	clock-frequency = <DT_FREQ_M(2)>;
};
