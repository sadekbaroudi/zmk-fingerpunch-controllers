/*
 * Copyright (c) 2021 Peter Johanson
 *
 * SPDX-License-Identifier: Apache-2.0
 */

/ {

	vik_conn: vik_connector {
		compatible = "sadekbaroudi,vik-connector";
		#gpio-cells = <2>;
		gpio-map-mask = <0xffffffff 0xffffffc0>;
		gpio-map-pass-thru = <0 0x3f>;
		gpio-map
			= <0 0 &gpio0 8 0>		// vik SDA
			, <1 0 &gpio0 9 0>		// vik SCL
			, <2 0 &gpio0 16 0>		// vik RGB Data
			, <3 0 &gpio0 18 0>		// vik AD_1
			, <4 0 &gpio0 15 0>		// vik MOSI
			, <5 0 &gpio0 10 0>		// vik AD_2
			, <6 0 &gpio0 13 0>		// vik CS
			, <7 0 &gpio0 12 0>		// vik MISO
			, <8 0 &gpio0 14 0>		// vik SCLK
			;
	};

	/**
	// v0.1
	vik_conn: vik_connector {
		compatible = "sadekbaroudi,vik-connector";
		#gpio-cells = <2>;
		gpio-map-mask = <0xffffffff 0xffffffc0>;
		gpio-map-pass-thru = <0 0x3f>;
		gpio-map
			= <0 0 &gpio0 22 0>		// vik SDA
			, <1 0 &gpio0 23 0>		// vik SCL
			, <2 0 &gpio0 16 0>		// vik RGB Data
			, <3 0 &gpio0 18 0>		// vik AD_1
			, <4 0 &gpio0 15 0>		// vik MOSI
			, <5 0 &gpio0 10 0>		// vik AD_2
			, <6 0 &gpio0 13 0>		// vik CS
			, <7 0 &gpio0 12 0>		// vik MISO
			, <8 0 &gpio0 14 0>		// vik SCLK
			;
	};
	*/
};

vik_i2c: &i2c0 {};
vik_spi: &spi1 {};
