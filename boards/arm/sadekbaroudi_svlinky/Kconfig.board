## boards/arm/sadekbaroudi_svlinky/Kconfig.board
```kconfig
# Copyright (c) 2021 Pete Johanson
# SPDX-License-Identifier: Apache-2.0

config BOARD_SADEKBAROUDI_SVLINKY
	bool "Sadekbaroudi svlinky"
	depends on SOC_RP2040
```

## boards/arm/sadekbaroudi_svlinky/Kconfig.defconfig
```kconfig
# Copyright (c) 2021 Pete Johanson
# SPDX-License-Identifier: Apache-2.0

if BOARD_SADEKBAROUDI_SVLINKY

config BOARD
	default "sadekbaroudi_svlinky"

config RP2_FLASH_W25Q080
	default y

endif # BOARD_SADEKBAROUDI_SVLINKY
```

## boards/arm/sadekbaroudi_xivik/Kconfig.board
```kconfig
# Copyright (c) 2021 Pete Johanson
# SPDX-License-Identifier: Apache-2.0

config BOARD_SADEKBAROUDI_XIVIK
	bool "Sadekbaroudi xivik"
	depends on SOC_RP2040
```

## boards/arm/sadekbaroudi_xivik/Kconfig.defconfig
```kconfig
# Copyright (c) 2021 Pete Johanson
# SPDX-License-Identifier: Apache-2.0

if BOARD_SADEKBAROUDI_XIVIK

config BOARD
	default "sadekbaroudi_xivik"

config RP2_FLASH_W25Q080
	default y

endif # BOARD_SADEKBAROUDI_XIVIK
```

## boards/arm/svlinky/Kconfig.board
```kconfig
# Copyright (c) 2021 Pete Johanson
# SPDX-License-Identifier: Apache-2.0

config BOARD_SVLINKY
	bool "svlinky"
	depends on SOC_RP2040
```

## boards/arm/svlinky/Kconfig.defconfig
```kconfig
# Copyright (c) 2021 Pete Johanson
# SPDX-License-Identifier: Apache-2.0

if BOARD_SVLINKY

config BOARD
	default "svlinky"

config RP2_FLASH_W25Q080
	default y

endif # BOARD_SVLINKY
```

## boards/arm/vikoto/Kconfig.board
```kconfig
# vikoto board configuration

# Copyright (c) 2020 The ZMK Contributors
# SPDX-License-Identifier: MIT

config BOARD_VIKOTO
    bool "vikoto"
    depends on SOC_NRF52840_QIAA
```

## boards/arm/vikoto/Kconfig.defconfig
```kconfig
# Electronut Labs Papyr board configuration

# Copyright (c) 2020 The ZMK Contributors
# SPDX-License-Identifier: MIT

if BOARD_VIKOTO

config BOARD
    default "vikoto"

if USB

config USB_NRFX
    default y

config USB_DEVICE_STACK
    default y

endif # USB

config BT_CTLR
    default BT

choice BOARD_VIKOTO_CHARGER_CURRENT
    default BOARD_VIKOTO_CHARGER_CURRENT_100MA
endchoice

endif # BOARD_VIKOTO
```

## boards/arm/xivik/Kconfig.defconfig
```kconfig
# Copyright (c) 2021 Pete Johanson
# SPDX-License-Identifier: Apache-2.0

if BOARD_XIVIK

config BOARD
	default "xivik"

config RP2_FLASH_W25Q080
	default y

endif # BOARD_XIVIK
```
